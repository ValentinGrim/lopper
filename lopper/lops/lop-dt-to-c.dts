/*
 * Author:
 *       Valentin Monnot <vmonnot@outlook.com>
 *
 * SPDX-License-Identifier: BSD-3-Clause
 */

 /dts-v1/;

 / {
	 compatible = "system-device-tree-v1";
	 priority = <1>;
	 lops {
		 lop_0 {
			 compatible = "system-device-tree-v1,lop,load";
			 load = "assists/dt_to_c.py";
		 };
		 lop_1 {
			 compatible = "system-device-tree-v1,lop,assist-v1";
			 node = "/";
			 id = "baremetal_config,generate";
             // First arg is path for output files
             // Seconde is the optional writter mode
			 options = "build boolean";
		 };
	 };
 };
